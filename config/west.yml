## config/west.yml
```yaml
manifest:
  remotes:
    - name: zmkfirmware
      url-base: https://github.com/zmkfirmware
    - name: mctechnology17
      url-base: https://github.com/mctechnology17
    - name: urob
      url-base: https://github.com/urob
  projects:
    - name: zmk
      remote: zmkfirmware
      revision: main
      import: app/west.yml
    # nice_oled module for enhanced OLED/nice!view display with WPM
    - name: zmk-nice-oled
      remote: mctechnology17
      revision: main
    # zmk-auto-layer for smart-num (numword) behavior
    - name: zmk-auto-layer
      remote: urob
      revision: main
  self:
    path: config
```
